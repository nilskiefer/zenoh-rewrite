## CMakeLists.txt
```
cmake_minimum_required(VERSION 3.20.0)
find_package(Zephyr REQUIRED HINTS $ENV{ZEPHYR_BASE})

project(basic-zenoh-test)

target_sources(app PRIVATE src/main.c)
```

## prj.conf
```kconfig
# Truly portable Zenoh publisher - works with any console device
# Pure serial transport only, no networking whatsoever

# Basic system configuration
CONFIG_POSIX_API=y
CONFIG_ENTROPY_GENERATOR=y
CONFIG_TEST_RANDOM_GENERATOR=y

# Console and logging
CONFIG_CONSOLE=y
CONFIG_PRINTK=y
CONFIG_LOG=y

# Serial interfaces - generic support
CONFIG_SERIAL=y
CONFIG_UART_INTERRUPT_DRIVEN=y
CONFIG_UART_LINE_CTRL=y

# Console device configuration
CONFIG_UART_CONSOLE=y

# ZENOH Configuration - MINIMAL SERIAL ONLY
CONFIG_ZENOH_PICO=y
CONFIG_ZENOH_PICO_PUBLICATION=y
CONFIG_ZENOH_PICO_LINK_SERIAL=y

# Explicitly disable network related features
CONFIG_NETWORKING=n
CONFIG_NET_SOCKETS=n
CONFIG_ZENOH_PICO_LINK_TCP=n
CONFIG_ZENOH_PICO_LINK_UDP_MULTICAST=n
CONFIG_ZENOH_PICO_LINK_UDP_UNICAST=n
CONFIG_ZENOH_PICO_SCOUTING_UDP=n

# Disable unnecessary Zenoh features
CONFIG_ZENOH_PICO_SUBSCRIPTION=n
CONFIG_ZENOH_PICO_QUERY=n
CONFIG_ZENOH_PICO_QUERYABLE=n
CONFIG_ZENOH_PICO_MULTI_THREAD=n

# Memory configuration
CONFIG_MAIN_STACK_SIZE=4096
CONFIG_HEAP_MEM_POOL_SIZE=8192
```

## src/main.c
```c
#include <stdio.h>
#include <string.h>
#include <zenoh-pico.h>
#include <zephyr/device.h>
#include <zephyr/kernel.h>

#define KEYEXPR "demo/example/zenoh-pico-pub"
#define VALUE "[PORTABLE] Pub from Zenoh-Pico!"

void main(void) {
    printf("=== Testing Zenoh Serial Transport ===\n");
    printf("Board: %s\n", CONFIG_BOARD);

    // Wait for console to be ready
    k_sleep(K_SECONDS(1));

    printf("Testing keyexpr creation...\n");
    z_owned_keyexpr_t keyexpr;
    if (z_keyexpr_from_str(&keyexpr, KEYEXPR) != 0) {
        printf("❌ Unable to create keyexpr!\n");
        return;
    }
    printf("✓ Keyexpr created successfully\n");

    printf("Testing config creation...\n");
    z_owned_config_t config;
    if (z_config_default(&config) != 0) {
        printf("❌ Unable to create config!\n");
        return;
    }
    printf("✓ Config created successfully\n");

    // Configure for serial transport with more debugging
    printf("Configuring serial transport...\n");
    zp_config_insert(z_loan_mut(config), Z_CONFIG_MODE_KEY, "client");
    zp_config_insert(z_loan_mut(config), Z_CONFIG_CONNECT_KEY, "serial/console#baudrate=115200");
    printf("✓ Serial transport configured\n");

    printf("Opening Zenoh Session...\n");
    z_owned_session_t session;
    z_result_t result = z_open(&session, z_move(config), NULL);
    if (result != 0) {
        printf("❌ Unable to open session! Error: %d\n", result);
        return;
    }
    printf("✓ Zenoh session opened successfully!\n");

    printf("Declaring publisher for '%s'...\n", KEYEXPR);
    z_owned_publisher_t pub;
    if (z_declare_publisher(z_loan(session), &pub, z_loan(keyexpr), NULL) != 0) {
        printf("❌ Unable to declare publisher!\n");
        z_drop(z_move(session));
        z_drop(z_move(keyexpr));
        return;
    }
    printf("✓ Publisher declared\n");

    printf("\n🚀 Ready! Publishing data every second...\n");

    char buf[256];
    int idx = 0;

    while (1) {
        k_sleep(K_SECONDS(1));
        snprintf(buf, sizeof(buf), "[%04d] %s (Board: %s)", idx++, VALUE, CONFIG_BOARD);

        printf("📤 [%04d] Publishing: '%s'\n", idx - 1, buf);

        z_owned_bytes_t payload;
        z_bytes_copy_from_buf(&payload, (const uint8_t *)buf, strlen(buf));
        z_result_t res = z_publisher_put(z_loan(pub), z_move(payload), NULL);

        if (res != 0) {
            printf("⚠️  Failed to publish (error: %d)\n", res);
        } else {
            printf("✅ Published successfully!\n");
        }
    }

    // Cleanup (never reached in this example)
    z_drop(z_move(pub));
    z_drop(z_move(session));
    z_drop(z_move(keyexpr));

    printf("✓ Test completed successfully!\n");
}
```
